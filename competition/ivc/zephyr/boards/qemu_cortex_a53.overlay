/* SPDX-License-Identifier: Apache-2.0 */

/*
 * Zephyr compiles this resource into its image. AxVM independently resolves
 * net0 to the same first AArch64 graph slot and emits the runtime FDT node.
 */
/ {
	ivc_virtio_mmio: virtio_mmio@b000000 {
		compatible = "virtio,mmio";
		reg = <0x0 0x0b000000 0x0 0x1000>;
		interrupt-parent = <&gic>;
		interrupts = <GIC_SPI 0 IRQ_TYPE_LEVEL IRQ_DEFAULT_PRIORITY>;
		status = "okay";

		ivc_virtio_net: ethernet {
			compatible = "virtio,net";
			local-mac-address = [52 54 00 00 00 02];
			status = "okay";
		};
	};
};

/* The AxVisor guest exposes only its configured virtio-net device. */
&eth0 {
	status = "disabled";
};
